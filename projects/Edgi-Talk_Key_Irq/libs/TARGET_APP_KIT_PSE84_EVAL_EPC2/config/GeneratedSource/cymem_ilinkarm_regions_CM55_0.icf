// This file is automatically generated.
// define memory with size = 4G;
define region m55_data_INTERNAL = [from 0x20000000 size 0x00040000];
define region m55_code_INTERNAL = [from 0x00000000 size 0x00040000];
define region m55_nvm = [from 0x60580000 size 0x002FFC00];
define region m55_code2 = [from 0x26000000 size 0x00080000];
define region m55_data2 = [from 0x26080000 size 0x00100000];
define region m33_m55_shared = [from 0x26180000 size 0x00300000];
define region gfx_mem = [from 0x26480000 size 0x00080000];
define region m33_m55_system_shared = [from 0x240FD000 size 0x00003000];
